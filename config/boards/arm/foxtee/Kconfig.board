## config/boards/arm/foxtee/Kconfig.board
```kconfig
# Jorian840 board configuration

# Copyright (c) 2022 The ZMK Contributors
# SPDX-License-Identifier: MIT

config BOARD_FOXTEE
	bool "foxtee"
	depends on SOC_NRF52840_QIAA
```
